## SPI_test/boards/arm/jhk/Kconfig.board
```kconfig
config BOARD_JHK
	bool "Custom Board auto generated by nRF Connect for VS Code"
	depends on SOC_NRF9161_LACA
```

## SPI_test/boards/arm/jhk/jhk_ns_defconfig
```kconfig
CONFIG_SOC_SERIES_NRF91X=y
CONFIG_SOC_NRF9161_LACA=y
CONFIG_BOARD_JHK=y

CONFIG_ARM_MPU=y
CONFIG_HW_STACK_PROTECTION=y

CONFIG_ARM_TRUSTZONE_M=y
CONFIG_TRUSTED_EXECUTION_NONSECURE=y

CONFIG_PINCTRL=y
```

## mqtt_working/build/Kconfig/Kconfig.shield
```kconfig
osource "c:/ncs/v2.6.0/zephyr/samples/drivers/spi_flash/boards/shields/*/Kconfig.shield"
osource "c:/ncs/v2.6.0/zephyr/samples/drivers/adc/boards/shields/*/Kconfig.shield"
osource "c:/ncs/v2.6.0/nrf/applications/serial_lte_modem/boards/shields/*/Kconfig.shield"
osource "c:/ncs/v2.6.0/zephyr/samples/net/mqtt_publisher/boards/shields/*/Kconfig.shield"
osource "C:/ncs/v2.6.0/nrf/boards/shields/*/Kconfig.shield"
```

## mqtt_working/build/Kconfig/Kconfig.shield.defconfig
```kconfig
osource "c:/ncs/v2.6.0/zephyr/samples/drivers/spi_flash/boards/shields/*/Kconfig.defconfig"
osource "c:/ncs/v2.6.0/zephyr/samples/drivers/adc/boards/shields/*/Kconfig.defconfig"
osource "c:/ncs/v2.6.0/nrf/applications/serial_lte_modem/boards/shields/*/Kconfig.defconfig"
osource "c:/ncs/v2.6.0/zephyr/samples/net/mqtt_publisher/boards/shields/*/Kconfig.defconfig"
osource "C:/ncs/v2.6.0/nrf/boards/shields/*/Kconfig.defconfig"
```

## mqtt_working/build/mqtt_working/Kconfig/boards/Kconfig
```kconfig
# Load Zephyr board Kconfig descriptions.
osource "C:/ncs/v2.9.0/zephyr/boards/nordic/nrf9161dk/Kconfig"
```

## nrf_cloud_rest_fota/build/Kconfig/Kconfig.shield
```kconfig
osource "c:/ncs/v2.6.0/zephyr/samples/drivers/spi_flash/boards/shields/*/Kconfig.shield"
osource "c:/ncs/v2.6.0/zephyr/samples/drivers/adc/boards/shields/*/Kconfig.shield"
osource "c:/ncs/v2.6.0/nrf/applications/serial_lte_modem/boards/shields/*/Kconfig.shield"
osource "c:/adwitech/nrf9160_examples/nrf_cloud_rest_fota/boards/shields/*/Kconfig.shield"
osource "C:/ncs/v2.6.0/nrf/boards/shields/*/Kconfig.shield"
```

## nrf_provisioning/build/Kconfig/Kconfig.shield.defconfig
```kconfig
osource "c:/ncs/v2.6.0/zephyr/samples/drivers/spi_flash/boards/shields/*/Kconfig.defconfig"
osource "c:/ncs/v2.6.0/zephyr/samples/drivers/adc/boards/shields/*/Kconfig.defconfig"
osource "c:/ncs/v2.6.0/nrf/applications/serial_lte_modem/boards/shields/*/Kconfig.defconfig"
osource "c:/adwitech/nrf9160_examples/nrf_cloud_rest_fota/boards/shields/*/Kconfig.defconfig"
osource "C:/ncs/v2.6.0/nrf/boards/shields/*/Kconfig.defconfig"
```

## sms/build/Kconfig/boards/Kconfig.defconfig
```kconfig
# Load Zephyr board defconfig descriptions.
osource "C:/ncs/v2.9.0/zephyr/boards/nordic/nrf9161dk/Kconfig.defconfig"
```

## sms2/build/Kconfig/Kconfig.shield
```kconfig
osource "c:/ncs/v2.6.0/zephyr/samples/drivers/spi_flash/boards/shields/*/Kconfig.shield"
osource "c:/ncs/v2.6.0/zephyr/samples/drivers/adc/boards/shields/*/Kconfig.shield"
osource "C:/ncs/v2.6.0/nrf/boards/shields/*/Kconfig.shield"
```

## sms2/build/Kconfig/Kconfig.shield.defconfig
```kconfig
osource "c:/ncs/v2.6.0/zephyr/samples/drivers/spi_flash/boards/shields/*/Kconfig.defconfig"
osource "c:/ncs/v2.6.0/zephyr/samples/drivers/adc/boards/shields/*/Kconfig.defconfig"
osource "C:/ncs/v2.6.0/nrf/boards/shields/*/Kconfig.defconfig"
```
