/dts-v1/;
#include <nordic/nrf9161_laca.dtsi>
#include "jhk-pinctrl.dtsi"
#include "jhk-partitioning.dtsi"

/ {
	chosen {
		zephyr,sram = &sram0_s;
		zephyr,flash = &flash0;
		zephyr,code-partition = &slot0_partition;
		zephyr,sram-secure-partition = &sram0_s;
		zephyr,sram-non-secure-partition = &sram0_ns;
	};
};
